## sdkconfig.defaults
```kconfig
# Required by esp_matter / CHIP SDK (HKDF for crypto)
#CONFIG_MBEDTLS_HKDF_C=y

# Matter example binary (~2.2 MB) requires 4 MB flash and a custom partition table.
# CONFIG_ESPTOOLPY_FLASHSIZE_4MB=y
# CONFIG_PARTITION_TABLE_CUSTOM=y
# CONFIG_PARTITION_TABLE_CUSTOM_FILENAME="partitions_matter.csv"

CONFIG_COMPILER_OPTIMIZATION_NONE=n
CONFIG_COMPILER_OPTIMIZATION_DEFAULT=y
CONFIG_COMPILER_OPTIMIZATION_PERF=n
CONFIG_COMPILER_OPTIMIZATION_SIZE=n
CONFIG_ESP_WIFI_ENABLED=y
# CONFIG_SPI_FLASH_DANGEROUS_WRITE_FAILS=y
# CONFIG_COMPILER_STACK_CHECK_MODE_STRONG=y
# CONFIG_COMPILER_STACK_CHECK=y


# This allows to use 1 ms granuality for thread sleeps (10 ms by default).
# CONFIG_FREERTOS_HZ=1000

# not working using `HeapCapsAllocator`,
# but std `raw_c_allocator` or `VPortAllocator` works
# CONFIG_HEAP_TASK_TRACKING=y

# CONFIG_BLINK_LED_STRIP=y
# CONFIG_BLINK_LED_STRIP_BACKEND_SPI=y
# CONFIG_BLINK_GPIO=48
```

## sdkconfig.defaults.esp32
```kconfig
CONFIG_ESP_TIMER_PROFILING=y
CONFIG_COMPILER_OPTIMIZATION_PERF=y
CONFIG_ESP_WIFI_ENABLED=y
CONFIG_BT_ENABLED=y
CONFIG_ESP_COEX_ENABLED=y
CONFIG_COMPILER_CXX_EXCEPTIONS=y
CONFIG_COMPILER_CXX_RTTI=y
```
